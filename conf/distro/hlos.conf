## conf/distro/hlos.conf
```bitbake
DISTRO = "hlos"
DISTRO_NAME = "hlOS (HomeLock Operating System)"
DISTRO_VERSION = "1.0.0.0"

IMAGE_INSTALL_append = " apache2"
IMAGE_INSTALL_append = " hlosgui"

# opengl provided virtual/egl
DISTRO_FEATURES_append = " opengl"

# Add systemd
DISTRO_FEATURES_append = " systemd"
DISTRO_FEATURES_BACKFILL_CONSIDERED += "sysvinit"
VIRTUAL-RUNTIME_init_manager = "systemd"
VIRTUAL-RUNTIME_initscripts = "systemd-compat-units"

# Add wifi
DISTRO_FEATURES_append = " wifi"
IMAGE_INSTALL_append = " linux-firmware-bcm43430 bluez5 i2c-tools bridge-utils hostapd dhcp-server iptables wpa-supplicant"

# Add compatability for tk
PNWHITELIST_openembedded-layer += ' tk cdrkit'

# Enable tk for use of python tkinter lib
PACKAGECONFIG[tk] = ",,tk"
```

## conf/layer.conf
```bitbake
# We have a conf and classes directory, append to BBPATH
BBPATH .= ":${LAYERDIR}"

# We have a recipes directory, add to BBFILES
BBFILES += "${LAYERDIR}/recipes*/*/*.bb ${LAYERDIR}/recipes*/*/*.bbappend"

BBFILE_COLLECTIONS += "meta-homelock"
BBFILE_PATTERN_meta-homelock := "^${LAYERDIR}/"
# increase the number
BBFILE_PRIORITY_meta-homelock = "7"
LAYERSERIES_COMPAT_meta-altera = "dunfell"


#IMAGE_INSTALL_append = " hlosgui"
```
